// SPDX-License-Identifier: (GPL-2.0-only OR BSD-2-Clause)
/* Visible boot-boundary derivative; never use as the final device tree. */

#include "sun50i-h700-anbernic-rg34xx-sp-bird.dts"

/ {
	model = "Anbernic RG34XX-SP (the user boot diagnostic)";

	leds {
		led-1 {
			linux,default-trigger = "heartbeat";
			panic-indicator;
		};
	};
};
